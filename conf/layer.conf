## conf/layer.conf
```bitbake
BBPATH .= ":${LAYERDIR}"

BBFILES += "${LAYERDIR}/recipes-*/*/*.bb \
             ${LAYERDIR}/recipes-*/*/*.bbappend"

BBFILE_COLLECTIONS += "meta-demo"
BBFILE_PATTERN_meta-demo = "^${LAYERDIR}/recipes-"
BBFILE_PRIORITY_meta-demo = "200"

LAYERSERIES_COMPAT_meta-demo = "next master"

LAYERDIR_meta-demo = "${LAYERDIR}"
```
